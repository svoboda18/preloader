
&NR_RNKS=2
; EMI setting
if &NR_RNKS==2
(
D.S SD:0x10219000 %LE %LONG 0x00025052; EMI_CONA
)
else
(
D.S SD:0x10219000 %LE %LONG 0x00005052; EMI_CONA
)
D.S SD:0x10219060 %LE %LONG 0x00000400; EMI_CONM
D.S SD:0x1021A010 %LE %LONG 0x00000001; CHN_EMI_CONC

; DDRPHY setting
if &NR_RNKS==2
(
D.S SD:0x1001E110 %LE %LONG 0x03051192;
)
else
(
D.S SD:0x1001E110 %LE %LONG 0x00051180;
)
D.S SD:0x1001E048 %LE %LONG 0x0000110d;
D.S SD:0x1001E0D8 %LE %LONG 0x00500900;
D.S SD:0x1001E0E4 %LE %LONG 0x00000001;
D.S SD:0x1001E08c %LE %LONG 0x00000001;
D.S SD:0x1001E090 %LE %LONG 0x00000000;
D.S SD:0x1001E094 %LE %LONG 0x80000000;
D.S SD:0x1001E0DC %LE %LONG 0x83004004;
D.S SD:0x1001E0E0 %LE %LONG 0x01004004;
D.S SD:0x1001E0F0 %LE %LONG 0x00000000;
D.S SD:0x1001E0F4 %LE %LONG 0x01000000;
D.S SD:0x1001E168 %LE %LONG 0x00000080;
D.S SD:0x1001E0D8 %LE %LONG 0x00700900;
D.S SD:0x1001E004 %LE %LONG 0xF00487A2;
D.S SD:0x1001E07C %LE %LONG 0x900641c0; ;@hj, ori=0x900641c0
D.S SD:0x1001E028 %LE %LONG 0xF1200F01;
D.S SD:0x1001E1E0 %LE %LONG 0x3001ebff;
D.S SD:0x1001E158 %LE %LONG 0x00000000;
D.S SD:0x1001E0e4 %LE %LONG 0x00000005;
wait 1.ms
D.S SD:0x1001E088 %LE %LONG 0x0000003F;
wait 1.ms
D.S SD:0x1001E088 %LE %LONG 0x00FF000A;
wait 1.ms
D.S SD:0x1001E088 %LE %LONG 0x00320001;
wait 1.ms
D.S SD:0x1001E088 %LE %LONG 0x00020002;
wait 1.ms
D.S SD:0x1001E0E4 %LE %LONG 0x00000001;
D.S SD:0x1001E084 %LE %LONG 0x00000a56;
D.S SD:0x1001E00C %LE %LONG 0x00000000;
D.S SD:0x1001E000 %LE %LONG 0x45D84408;
D.S SD:0x1001E044 %LE %LONG 0xa8080401;
D.S SD:0x1001E1E8 %LE %LONG 0x00000510;
D.S SD:0x1001E008 %LE %LONG 0x03406340;
D.S SD:0x1001E010 %LE %LONG 0x00000000;
D.S SD:0x1001E0F8 %LE %LONG 0xEDCB000F;
D.S SD:0x1001E0FC %LE %LONG 0x27010000;

; DRAMC setting
if &NR_RNKS==2
(
D.S SD:0x1001D110 %LE %LONG 0x04051192;
D.S SD:0x1001D124 %LE %LONG 0xaa080000;
D.S SD:0x1001D118 %LE %LONG 0x00000001;
)
else
(
D.S SD:0x1001D110 %LE %LONG 0x00051180;
)
D.S SD:0x1001D048 %LE %LONG 0x0000110d;
D.S SD:0x1001D0D8 %LE %LONG 0x00500900;
D.S SD:0x1001D0E4 %LE %LONG 0x00000001;
D.S SD:0x1001D08c %LE %LONG 0x00000001;
D.S SD:0x1001D090 %LE %LONG 0x00000000;
D.S SD:0x1001D094 %LE %LONG 0x80000000;
D.S SD:0x1001D0DC %LE %LONG 0x83004004;
D.S SD:0x1001D0E0 %LE %LONG 0x01004004;
D.S SD:0x1001D0F0 %LE %LONG 0x00000000;
D.S SD:0x1001D0F4 %LE %LONG 0x01000000;
D.S SD:0x1001D168 %LE %LONG 0x00000080;
D.S SD:0x1001D0D8 %LE %LONG 0x00700900;
D.S SD:0x1001D004 %LE %LONG 0xF00487A2;
D.S SD:0x1001D07C %LE %LONG 0x900641c0; ;@hj, ori=0x900641c0
D.S SD:0x1001D028 %LE %LONG 0xF1200F01;
D.S SD:0x1001D1E0 %LE %LONG 0x3001ebff;
D.S SD:0x1001D158 %LE %LONG 0x00000000;
D.S SD:0x1001D0e4 %LE %LONG 0x00000005;
;wait 1.ms
D.S SD:0x1001D088 %LE %LONG 0x0000003F;
D.S SD:0x1001D1E4 %LE %LONG 0x00000001;
D.S SD:0x1001D1E4 %LE %LONG 0x00000000;
D.S SD:0x1001D1E4 %LE %LONG 0x00000000;
D.S SD:0x1001D1E4 %LE %LONG 0x00000000;
D.S SD:0x1001D1E4 %LE %LONG 0x00000000;
D.S SD:0x1001D1E4 %LE %LONG 0x00000000;
D.S SD:0x1001D1E4 %LE %LONG 0x00000000;
D.S SD:0x1001D1E4 %LE %LONG 0x00000000;
D.S SD:0x1001D1E4 %LE %LONG 0x00000000;
D.S SD:0x1001D1E4 %LE %LONG 0x00000000;
D.S SD:0x1001D1E4 %LE %LONG 0x00000000;
;wait 1.ms
D.S SD:0x1001D088 %LE %LONG 0x00FF000A;
D.S SD:0x1001D1E4 %LE %LONG 0x00000001;
D.S SD:0x1001D1E4 %LE %LONG 0x00000000;
D.S SD:0x1001D1E4 %LE %LONG 0x00000000;
D.S SD:0x1001D1E4 %LE %LONG 0x00000000;
D.S SD:0x1001D1E4 %LE %LONG 0x00000000;
D.S SD:0x1001D1E4 %LE %LONG 0x00000000;
D.S SD:0x1001D1E4 %LE %LONG 0x00000000;
D.S SD:0x1001D1E4 %LE %LONG 0x00000000;
D.S SD:0x1001D1E4 %LE %LONG 0x00000000;
D.S SD:0x1001D1E4 %LE %LONG 0x00000000;
D.S SD:0x1001D1E4 %LE %LONG 0x00000000;
;wait 1.ms
D.S SD:0x1001D088 %LE %LONG 0x00320001;
D.S SD:0x1001D1E4 %LE %LONG 0x00000001;
D.S SD:0x1001D1E4 %LE %LONG 0x00000000;
D.S SD:0x1001D1E4 %LE %LONG 0x00000000;
D.S SD:0x1001D1E4 %LE %LONG 0x00000000;
D.S SD:0x1001D1E4 %LE %LONG 0x00000000;
D.S SD:0x1001D1E4 %LE %LONG 0x00000000;
D.S SD:0x1001D1E4 %LE %LONG 0x00000000;
D.S SD:0x1001D1E4 %LE %LONG 0x00000000;
D.S SD:0x1001D1E4 %LE %LONG 0x00000000;
D.S SD:0x1001D1E4 %LE %LONG 0x00000000;
D.S SD:0x1001D1E4 %LE %LONG 0x00000000;
;wait 1.ms
D.S SD:0x1001D088 %LE %LONG 0x00020002;
D.S SD:0x1001D1E4 %LE %LONG 0x00000001;
D.S SD:0x1001D1E4 %LE %LONG 0x00001100;
D.S SD:0x1001D1E4 %LE %LONG 0x00000000;
D.S SD:0x1001D1E4 %LE %LONG 0x00000000;
D.S SD:0x1001D1E4 %LE %LONG 0x00000000;
D.S SD:0x1001D1E4 %LE %LONG 0x00000000;
D.S SD:0x1001D1E4 %LE %LONG 0x00000000;
D.S SD:0x1001D1E4 %LE %LONG 0x00000000;
D.S SD:0x1001D1E4 %LE %LONG 0x00000000;
D.S SD:0x1001D1E4 %LE %LONG 0x00000000;
D.S SD:0x1001D1E4 %LE %LONG 0x00000000;
;wait 1.ms
;D.S SD:0x1001D110 %LE %LONG 0x00111190;
D.S SD:0x1001D0E4 %LE %LONG 0x00000001;
D.S SD:0x1001D084 %LE %LONG 0x00000a56;
D.S SD:0x1001D00C %LE %LONG 0x00000000;
D.S SD:0x1001D000 %LE %LONG 0x45D84408;
D.S SD:0x1001D044 %LE %LONG 0xa8080401;
D.S SD:0x1001D1E8 %LE %LONG 0x00000510;
D.S SD:0x1001D008 %LE %LONG 0x03406340;
D.S SD:0x1001D010 %LE %LONG 0x00000000;
D.S SD:0x1001D0F8 %LE %LONG 0xEDCB000F;
D.S SD:0x1001D0FC %LE %LONG 0x27010000;
