&NR_RNKS=1
;EMI
;0x10330***

;DRAMC0_NAO
;0x1022c***
;DRAMC0
;0x1022A***
;DRAMC1
;0x10232***
;DDRPHY0
;0x10228***
;DDRPHY1
;0x10230***

;EMI setting
D.S SD:0x10219000 %LE %LONG 0x00025052;
D.S SD:0x10219060 %LE %LONG 0xff000400;
D.S SD:0x10219020 %LE %LONG 0x00008000;
D.S SD:0x1022d000 %LE %LONG 0x00005053;
D.S SD:0x1022d010 %LE %LONG 0x00000001;


;;;;;;;;;;;;;;;;;;;;;;;;;;;;;;;;;;;;;;;;;;;;;;;
D.S SD:0x10228274 %LE %LONG 0xffffffff;
D.S SD:0x10230278 %LE %LONG 0x00000000;
D.S SD:0x10230274 %LE %LONG 0xffffffff;
D.S SD:0x1022829C %LE %LONG 0x38030000;
;PLL sel

D.S SD:0x102281a0 %LE %LONG 0x00000000;
D.S SD:0x102280a0 %LE %LONG 0x00000000;
D.S SD:0x10228120 %LE %LONG 0x00000000;
D.S SD:0x102282ac %LE %LONG 0x80000006;
D.S SD:0x102301a0 %LE %LONG 0x00000000;
D.S SD:0x102300a0 %LE %LONG 0x00000000;
D.S SD:0x10230120 %LE %LONG 0x00000000;
D.S SD:0x102302ac %LE %LONG 0x80000006;
D.S SD:0x102282a0 %LE %LONG 0x00000100; ;PINMUX
D.S SD:0x102302a0 %LE %LONG 0x00000100;
D.S SD:0x10228264 %LE %LONG 0x00400000;
D.S SD:0x10228268 %LE %LONG 0x00000040;
D.S SD:0x10230264 %LE %LONG 0x00400000;
D.S SD:0x10230268 %LE %LONG 0x00000040;
D.S SD:0x10228e18 %LE %LONG 0x00000000;
D.S SD:0x10228f18 %LE %LONG 0x01010000;
D.S SD:0x10229018 %LE %LONG 0x02020000;
D.S SD:0x10228e68 %LE %LONG 0x04040000;
D.S SD:0x10228f68 %LE %LONG 0x05050000;
D.S SD:0x10229068 %LE %LONG 0x06060000;
D.S SD:0x10228ec4 %LE %LONG 0x00000c00;
D.S SD:0x10228fc4 %LE %LONG 0x00000c00;
D.S SD:0x102293c4 %LE %LONG 0x00000c00;
D.S SD:0x102294c4 %LE %LONG 0x00000c00;
D.S SD:0x10228e50 %LE %LONG 0x00000000;
D.S SD:0x10228f50 %LE %LONG 0xbbbbbbbb;
D.S SD:0x10229050 %LE %LONG 0xbbbbbbbb;
D.S SD:0x10228e54 %LE %LONG 0x00000000;
D.S SD:0x10228f54 %LE %LONG 0x0000bb00;
D.S SD:0x10229054 %LE %LONG 0x0000bb00;
D.S SD:0x10230ea0 %LE %LONG 0x00000000;
D.S SD:0x10230fa0 %LE %LONG 0x00bbbbbb;
D.S SD:0x102310a0 %LE %LONG 0x00bbbbbb;
D.S SD:0x10230ea4 %LE %LONG 0x00000000;
D.S SD:0x10230fa4 %LE %LONG 0x00000bbb;
D.S SD:0x102310a4 %LE %LONG 0x00000bbb;
D.S SD:0x10230e00 %LE %LONG 0x00000000;
D.S SD:0x10230f00 %LE %LONG 0xbbbbbbbb;
D.S SD:0x10231000 %LE %LONG 0xbbbbbbbb;
D.S SD:0x10230e04 %LE %LONG 0x00000000;
D.S SD:0x10230f04 %LE %LONG 0x0000bb00;
D.S SD:0x10231004 %LE %LONG 0x0000bb00;
D.S SD:0x10230e50 %LE %LONG 0x00000000;
D.S SD:0x10230f50 %LE %LONG 0xbbbbbbbb;
D.S SD:0x10231050 %LE %LONG 0xbbbbbbbb;
D.S SD:0x10230e54 %LE %LONG 0x00000000;
D.S SD:0x10230f54 %LE %LONG 0x0000bb00;
D.S SD:0x10231054 %LE %LONG 0x0000bb00;
D.S SD:0x10228e1c %LE %LONG 0x00000c00;
D.S SD:0x10228f1c %LE %LONG 0x00000c00;
D.S SD:0x1022901c %LE %LONG 0x00000c00;
D.S SD:0x10228e6c %LE %LONG 0x000f0f00;
D.S SD:0x10228f6c %LE %LONG 0x000f0f00;
D.S SD:0x1022906c %LE %LONG 0x000f0f00;
D.S SD:0x10230ec4 %LE %LONG 0x00000f0f;
D.S SD:0x10230fc4 %LE %LONG 0x00000f0f;
D.S SD:0x102310c4 %LE %LONG 0x00000f0f;
D.S SD:0x10230e1c %LE %LONG 0x000f0f00;
D.S SD:0x10230f1c %LE %LONG 0x000f0f00;
D.S SD:0x1023101c %LE %LONG 0x000f0f00;
D.S SD:0x10230e6c %LE %LONG 0x000f0f00;
D.S SD:0x10230f6c %LE %LONG 0x000f0f00;
D.S SD:0x1023106c %LE %LONG 0x000f0f00;
D.S SD:0x10228128 %LE %LONG 0x00001010;
D.S SD:0x1022812c %LE %LONG 0x01111010;
D.S SD:0x10228130 %LE %LONG 0x010c10d0;
D.S SD:0x1022812c %LE %LONG 0x03111010;
D.S SD:0x102281a4 %LE %LONG 0x0000008c;
;TINFO="SHL ddrphy chA reset release"
D.S SD:0x102281b0 %LE %LONG 0x00080010;  ;SER MODE
D.S SD:0x10228d04 %LE %LONG 0x00000101;
D.S SD:0x10228d08 %LE %LONG 0x00000101;
D.S SD:0x10229204 %LE %LONG 0x00000101;
D.S SD:0x10229208 %LE %LONG 0x00000101;
D.S SD:0x102280a4 %LE %LONG 0x0000008c;
D.S SD:0x102280b0 %LE %LONG 0x00080010;  ;SER MODE
D.S SD:0x10228c04 %LE %LONG 0x00000101;
D.S SD:0x10228c08 %LE %LONG 0x00000101;
D.S SD:0x10229104 %LE %LONG 0x00000101;
D.S SD:0x10229108 %LE %LONG 0x00000101;
D.S SD:0x102301a8 %LE %LONG 0x00001010;
D.S SD:0x102301ac %LE %LONG 0x01111010;
D.S SD:0x102301b0 %LE %LONG 0x010c10d0;
D.S SD:0x102301ac %LE %LONG 0x03111010;
D.S SD:0x102300a8 %LE %LONG 0x00001010;
D.S SD:0x102300ac %LE %LONG 0x01111010;
D.S SD:0x102300b0 %LE %LONG 0x010c10d0;
D.S SD:0x102300ac %LE %LONG 0x03111010;
D.S SD:0x10230128 %LE %LONG 0x00001010;
D.S SD:0x1023012c %LE %LONG 0x01111010;
D.S SD:0x10230130 %LE %LONG 0x010c10d0;
D.S SD:0x1023012c %LE %LONG 0x03111010;
;PLL
 
D.S SD:0x10228c18 %LE %LONG 0x04000000;
D.S SD:0x10229118 %LE %LONG 0x04000000;
D.S SD:0x10228c98 %LE %LONG 0x04000000;
D.S SD:0x10229198 %LE %LONG 0x04000000;
D.S SD:0x10228d18 %LE %LONG 0x04000000;
D.S SD:0x10229218 %LE %LONG 0x04000000;
D.S SD:0x10230c18 %LE %LONG 0x04000000;
D.S SD:0x10231118 %LE %LONG 0x04000000;
D.S SD:0x10230c98 %LE %LONG 0x04000000;
D.S SD:0x10231198 %LE %LONG 0x04000000;
D.S SD:0x10230d18 %LE %LONG 0x04000000;
D.S SD:0x10231218 %LE %LONG 0x04000000;
D.S SD:0x10228da0 %LE %LONG 0x00000000;
D.S SD:0x102292a0 %LE %LONG 0x00000000;
;   DLL

D.S SD:0x10228124 %LE %LONG 0x0000051e;
D.S SD:0x102301a4 %LE %LONG 0x0000051e;
;TINFO="SHL ddrphy chB reset release"
D.S SD:0x102300a4 %LE %LONG 0x0000051e;
D.S SD:0x10230124 %LE %LONG 0x0000051e;
D.S SD:0x10228194 %LE %LONG 0x00660600;
D.S SD:0x10228094 %LE %LONG 0xc0660600;
D.S SD:0x10228114 %LE %LONG 0xc0660600;
D.S SD:0x10230194 %LE %LONG 0xc0660600;
D.S SD:0x10230094 %LE %LONG 0xc0660600;
D.S SD:0x10230114 %LE %LONG 0xc0660600;
D.S SD:0x102281b8 %LE %LONG 0x00180101;
D.S SD:0x1022826c %LE %LONG 0x00000000;
D.S SD:0x102301b8 %LE %LONG 0x00180101;
D.S SD:0x1023026c %LE %LONG 0x00000000;
D.S SD:0x10228d14 %LE %LONG 0x00000000;
D.S SD:0x10229214 %LE %LONG 0x00000000;
D.S SD:0x10229714 %LE %LONG 0x00000000;
D.S SD:0x10229c14 %LE %LONG 0x00000000;
D.S SD:0x10230d14 %LE %LONG 0x00000000;
D.S SD:0x10231214 %LE %LONG 0x00000000;
D.S SD:0x10231714 %LE %LONG 0x00000000;
D.S SD:0x10231c14 %LE %LONG 0x00000000;

;wait 1.ms

D.S SD:0x1022800c %LE %LONG 0x006d0000;
D.S SD:0x10228180 %LE %LONG 0x0000000c;
D.S SD:0x10228080 %LE %LONG 0x00000009;
D.S SD:0x10228100 %LE %LONG 0x00000009;
D.S SD:0x10230180 %LE %LONG 0x00000009;
D.S SD:0x10230080 %LE %LONG 0x00000009;
D.S SD:0x10230100 %LE %LONG 0x00000009;

;wait 1.ms

D.S SD:0x10228000 %LE %LONG 0x80000000;
D.S SD:0x10228004 %LE %LONG 0x80000000;
D.S SD:0x10228004 %LE %LONG 0x00000000;

;wait 1.ms

D.S SD:0x10228da4 %LE %LONG 0x00019200;

;wait 1.ms

D.S SD:0x10228194 %LE %LONG 0x00660e00;

;wait 1.ms

D.S SD:0x10228094 %LE %LONG 0xc0660e00;
D.S SD:0x10228114 %LE %LONG 0xc0660e00;
D.S SD:0x10230194 %LE %LONG 0xc0660e00;
D.S SD:0x10230094 %LE %LONG 0xc0660e00;
D.S SD:0x10230114 %LE %LONG 0xc0660e00;
D.S SD:0x10228284 %LE %LONG 0x0000001f;

;wait 1.ms

D.S SD:0x10228124 %LE %LONG 0x0001051e;
D.S SD:0x102301a4 %LE %LONG 0x0001051e;
D.S SD:0x102300a4 %LE %LONG 0x0001051e;
D.S SD:0x10230124 %LE %LONG 0x0001051e;
D.S SD:0x102282a0 %LE %LONG 0x8100018c;
D.S SD:0x102302a0 %LE %LONG 0x8100018c;
D.S SD:0x102281b8 %LE %LONG 0x00040101;
D.S SD:0x102281b4 %LE %LONG 0x00000000;
D.S SD:0x102280b4 %LE %LONG 0x00000000;
D.S SD:0x10228134 %LE %LONG 0x00000000;
D.S SD:0x102301b4 %LE %LONG 0x00000000;
D.S SD:0x102300b4 %LE %LONG 0x00000000;
D.S SD:0x10230134 %LE %LONG 0x00000000;
D.S SD:0x1022A0dc %LE %LONG 0x00051008;
;;D.S SD:0x1023200dc %LE %LONG 0x00050008;
D.S SD:0x1022A000 %LE %LONG 0x02101000; ;[24]=LP2_EN , [25]=LP3_EN,  [26]=LP4_EN
D.S SD:0x1022A840 %LE %LONG 0xa208009f;
D.S SD:0x1022A860 %LE %LONG 0x00030053;
D.S SD:0x1022A04c %LE %LONG 0x25712000;
D.S SD:0x1022A880 %LE %LONG 0x00000000;
D.S SD:0x1022A884 %LE %LONG 0x00000000;
D.S SD:0x1022A888 %LE %LONG 0x00000000;
D.S SD:0x1022A88c %LE %LONG 0x00000000;
D.S SD:0x1022A890 %LE %LONG 0x11111011;
D.S SD:0x1022A894 %LE %LONG 0x01101111;
D.S SD:0x1022A898 %LE %LONG 0x11111111;
D.S SD:0x1022A89c %LE %LONG 0x11111111;
D.S SD:0x1022A8a0 %LE %LONG 0x11111111; ;TXDLY DQS
D.S SD:0x1022A8a4 %LE %LONG 0x66667777;
D.S SD:0x1022Aa2c %LE %LONG 0x11111111; ;TXDLY DQ
D.S SD:0x1022Aa30 %LE %LONG 0x11111111; ;TXDLY DQM
D.S SD:0x1022Aa34 %LE %LONG 0x66667777;
D.S SD:0x1022Aa38 %LE %LONG 0x66667777;
D.S SD:0x1022Ab2c %LE %LONG 0x22222222;
D.S SD:0x1022Ab30 %LE %LONG 0x22222222;
D.S SD:0x1022Ab34 %LE %LONG 0x66667777;
D.S SD:0x1022Ab38 %LE %LONG 0x66667777;
D.S SD:0x1022Ac2c %LE %LONG 0x22222222;
D.S SD:0x1022Ac30 %LE %LONG 0x22222222;
D.S SD:0x1022Ac34 %LE %LONG 0x66667777;
D.S SD:0x1022Ac38 %LE %LONG 0x66667777;
D.S SD:0x1022Aa1c %LE %LONG 0x00000000;
D.S SD:0x1022Aa20 %LE %LONG 0x00000000;
D.S SD:0x1022Ab1c %LE %LONG 0x00000000;
D.S SD:0x1022Ab20 %LE %LONG 0x00000000;
D.S SD:0x1022Ac1c %LE %LONG 0x00000000;
D.S SD:0x1022Ac20 %LE %LONG 0x66666666;

;wait 1.ms
D.S SD:0x10232060 %LE %LONG 0x00000000;
D.S SD:0x10232060 %LE %LONG 0x00000000;
D.S SD:0x10232060 %LE %LONG 0x00000000;


D.S SD:0x1022A200 %LE %LONG 0xf0100000; ;[31]=DQSIEN MODE
D.S SD:0x1022A048 %LE %LONG 0x08000000;
D.S SD:0x1022A878 %LE %LONG 0xc0000000;
D.S SD:0x1022A800 %LE %LONG 0x09030b06;
D.S SD:0x1022A804 %LE %LONG 0x14090901;
D.S SD:0x1022A808 %LE %LONG 0x0c050201;
D.S SD:0x1022A80c %LE %LONG 0x00490019;
D.S SD:0x1022A814 %LE %LONG 0x01000606;
D.S SD:0x1022A81c %LE %LONG 0x02030408;
D.S SD:0x1022A820 %LE %LONG 0x02000400;
D.S SD:0x1022A848 %LE %LONG 0x9007320f;
D.S SD:0x1022A844 %LE %LONG 0x00000b0d; ;DATLAT
D.S SD:0x1022A000 %LE %LONG 0x02111000; ;[24]=LP2_EN , [25]=LP3_EN,  [26]=LP4_EN
D.S SD:0x1022A004 %LE %LONG 0x20002000;
D.S SD:0x1022A008 %LE %LONG 0x81080000;
D.S SD:0x1022A00c %LE %LONG 0x0002cf13;
D.S SD:0x1022A010 %LE %LONG 0x00000080;
D.S SD:0x1022A020 %LE %LONG 0x00000009;
D.S SD:0x1022A024 %LE %LONG 0x80030000;
D.S SD:0x1022A038 %LE %LONG 0x80000106;
D.S SD:0x1022A040 %LE %LONG 0x3000000c;
D.S SD:0x1022A04c %LE %LONG 0x25714001;
D.S SD:0x1022A064 %LE %LONG 0x25b1f1cf; ;REFRDIS=1
D.S SD:0x1022A0b0 %LE %LONG 0x04300000;
D.S SD:0x1022A200 %LE %LONG 0xf0310000; ;[31]=DQSIEN MODE
D.S SD:0x1022A858 %LE %LONG 0x21200001;
D.S SD:0x1022Aa00 %LE %LONG 0x00000002;
D.S SD:0x1022Ab00 %LE %LONG 0x00000002;
D.S SD:0x1022Ac00 %LE %LONG 0x00000002;

;wait 1.ms
D.S SD:0x10232060 %LE %LONG 0x00000000;
D.S SD:0x10232060 %LE %LONG 0x00000000;
D.S SD:0x10232060 %LE %LONG 0x00000000;

D.S SD:0x1022Aa24 %LE %LONG 0x10101010;   ;GATE WINDOW unit:2T
D.S SD:0x1022Aa28 %LE %LONG 0x17171717;
D.S SD:0x1022Ab24 %LE %LONG 0x11111111;
D.S SD:0x1022Ab28 %LE %LONG 0x42424242;
D.S SD:0x1022Ac24 %LE %LONG 0x32323232;
D.S SD:0x1022Ac28 %LE %LONG 0x06060606;
;;D.S SD:0x10232a24 %LE %LONG 0x00000000;  ;GATE WINDOW unit:2T
;;D.S SD:0x10232a28 %LE %LONG 0x53535353;
;;D.S SD:0x10232b24 %LE %LONG 0x32323232;
;;D.S SD:0x10232b28 %LE %LONG 0x06060606;
;;D.S SD:0x10232c24 %LE %LONG 0x32323232;
;;D.S SD:0x10232c28 %LE %LONG 0x06060606;
;               33961 === over_write_setting_begin ===
;               33961 === over_write_setting_end ===
D.S SD:0x1022A034 %LE %LONG 0x00731010;
D.S SD:0x1022A024 %LE %LONG 0x80030050;

;wait 1.ms
D.S SD:0x10232060 %LE %LONG 0x00000000;
D.S SD:0x10232060 %LE %LONG 0x00000000;
D.S SD:0x10232060 %LE %LONG 0x00000000;
D.S SD:0x10232060 %LE %LONG 0x00000000;
D.S SD:0x10232060 %LE %LONG 0x00000000;
D.S SD:0x10232060 %LE %LONG 0x00000000;
D.S SD:0x10232060 %LE %LONG 0x00000000;
D.S SD:0x10232060 %LE %LONG 0x00000000;
D.S SD:0x10232060 %LE %LONG 0x00000000;

D.S SD:0x1022A05c %LE %LONG 0x00003f00;
D.S SD:0x1022A060 %LE %LONG 0x00000001;

;wait 1.ms
D.S SD:0x10232060 %LE %LONG 0x00000000;
D.S SD:0x10232060 %LE %LONG 0x00000000;
D.S SD:0x10232060 %LE %LONG 0x00000000;
D.S SD:0x10232060 %LE %LONG 0x00000000;
D.S SD:0x10232060 %LE %LONG 0x00000000;
D.S SD:0x10232060 %LE %LONG 0x00000000;
D.S SD:0x10232060 %LE %LONG 0x00000000;
D.S SD:0x10232060 %LE %LONG 0x00000000;
D.S SD:0x10232060 %LE %LONG 0x00000000;

D.S SD:0x1022A060 %LE %LONG 0x00000000;

;wait 1.ms
D.S SD:0x10232060 %LE %LONG 0x00000000;
D.S SD:0x10232060 %LE %LONG 0x00000000;
D.S SD:0x10232060 %LE %LONG 0x00000000;
D.S SD:0x10232060 %LE %LONG 0x00000000;
D.S SD:0x10232060 %LE %LONG 0x00000000;
D.S SD:0x10232060 %LE %LONG 0x00000000;
D.S SD:0x10232060 %LE %LONG 0x00000000;
D.S SD:0x10232060 %LE %LONG 0x00000000;
D.S SD:0x10232060 %LE %LONG 0x00000000;

D.S SD:0x1022A05c %LE %LONG 0x00000aff;
D.S SD:0x1022A060 %LE %LONG 0x00000001;

;wait 1.ms
D.S SD:0x10232060 %LE %LONG 0x00000000;
D.S SD:0x10232060 %LE %LONG 0x00000000;
D.S SD:0x10232060 %LE %LONG 0x00000000;
D.S SD:0x10232060 %LE %LONG 0x00000000;
D.S SD:0x10232060 %LE %LONG 0x00000000;
D.S SD:0x10232060 %LE %LONG 0x00000000;
D.S SD:0x10232060 %LE %LONG 0x00000000;
D.S SD:0x10232060 %LE %LONG 0x00000000;
D.S SD:0x10232060 %LE %LONG 0x00000000;

D.S SD:0x1022A060 %LE %LONG 0x00000000;

;wait 1.ms
D.S SD:0x10232060 %LE %LONG 0x00000000;
D.S SD:0x10232060 %LE %LONG 0x00000000;
D.S SD:0x10232060 %LE %LONG 0x00000000;
D.S SD:0x10232060 %LE %LONG 0x00000000;
D.S SD:0x10232060 %LE %LONG 0x00000000;
D.S SD:0x10232060 %LE %LONG 0x00000000;
D.S SD:0x10232060 %LE %LONG 0x00000000;
D.S SD:0x10232060 %LE %LONG 0x00000000;
D.S SD:0x10232060 %LE %LONG 0x00000000;

D.S SD:0x1022A05c %LE %LONG 0x00000183;
D.S SD:0x1022A060 %LE %LONG 0x00000001;

;wait 1.ms
D.S SD:0x10232060 %LE %LONG 0x00000000;
D.S SD:0x10232060 %LE %LONG 0x00000000;
D.S SD:0x10232060 %LE %LONG 0x00000000;
D.S SD:0x10232060 %LE %LONG 0x00000000;
D.S SD:0x10232060 %LE %LONG 0x00000000;
D.S SD:0x10232060 %LE %LONG 0x00000000;
D.S SD:0x10232060 %LE %LONG 0x00000000;
D.S SD:0x10232060 %LE %LONG 0x00000000;
D.S SD:0x10232060 %LE %LONG 0x00000000;

D.S SD:0x1022A060 %LE %LONG 0x00000000;
D.S SD:0x1022A05c %LE %LONG 0x00000206;  ;RL/WL
D.S SD:0x1022A060 %LE %LONG 0x00000001;

;wait 1.ms
D.S SD:0x10232060 %LE %LONG 0x00000000;
D.S SD:0x10232060 %LE %LONG 0x00000000;
D.S SD:0x10232060 %LE %LONG 0x00000000;
D.S SD:0x10232060 %LE %LONG 0x00000000;
D.S SD:0x10232060 %LE %LONG 0x00000000;
D.S SD:0x10232060 %LE %LONG 0x00000000;
D.S SD:0x10232060 %LE %LONG 0x00000000;
D.S SD:0x10232060 %LE %LONG 0x00000000;
D.S SD:0x10232060 %LE %LONG 0x00000000;

D.S SD:0x1022A060 %LE %LONG 0x00000000;   
D.S SD:0x1022A028 %LE %LONG 0x00000034;
D.S SD:0x1022A05c %LE %LONG 0x00000b03;  
D.S SD:0x1022A060 %LE %LONG 0x00000001;

;=============================RANK1 MRW==================

;wait 1.ms
D.S SD:0x10232060 %LE %LONG 0x00000000;
D.S SD:0x10232060 %LE %LONG 0x00000000;
D.S SD:0x10232060 %LE %LONG 0x00000000;
D.S SD:0x10232060 %LE %LONG 0x00000000;
D.S SD:0x10232060 %LE %LONG 0x00000000;
D.S SD:0x10232060 %LE %LONG 0x00000000;
D.S SD:0x10232060 %LE %LONG 0x00000000;
D.S SD:0x10232060 %LE %LONG 0x00000000;
D.S SD:0x10232060 %LE %LONG 0x00000000;

D.S SD:0x1022A060 %LE %LONG 0x00000000;   
D.S SD:0x1022A05c %LE %LONG 0x01003f00;  
D.S SD:0x1022A060 %LE %LONG 0x00000001;
;wait 1.ms
D.S SD:0x10232060 %LE %LONG 0x00000000;
D.S SD:0x10232060 %LE %LONG 0x00000000;
D.S SD:0x10232060 %LE %LONG 0x00000000;
D.S SD:0x10232060 %LE %LONG 0x00000000;
D.S SD:0x10232060 %LE %LONG 0x00000000;
D.S SD:0x10232060 %LE %LONG 0x00000000;
D.S SD:0x10232060 %LE %LONG 0x00000000;
D.S SD:0x10232060 %LE %LONG 0x00000000;
D.S SD:0x10232060 %LE %LONG 0x00000000;

D.S SD:0x1022A060 %LE %LONG 0x00000000;   
;wait 1.ms
D.S SD:0x10232060 %LE %LONG 0x00000000;
D.S SD:0x10232060 %LE %LONG 0x00000000;
D.S SD:0x10232060 %LE %LONG 0x00000000;
D.S SD:0x10232060 %LE %LONG 0x00000000;
D.S SD:0x10232060 %LE %LONG 0x00000000;
D.S SD:0x10232060 %LE %LONG 0x00000000;
D.S SD:0x10232060 %LE %LONG 0x00000000;
D.S SD:0x10232060 %LE %LONG 0x00000000;
D.S SD:0x10232060 %LE %LONG 0x00000000;

   
D.S SD:0x1022A05c %LE %LONG 0x01000aff;
D.S SD:0x1022A060 %LE %LONG 0x00000001;

;wait 1.ms
D.S SD:0x10232060 %LE %LONG 0x00000000;
D.S SD:0x10232060 %LE %LONG 0x00000000;
D.S SD:0x10232060 %LE %LONG 0x00000000;
D.S SD:0x10232060 %LE %LONG 0x00000000;
D.S SD:0x10232060 %LE %LONG 0x00000000;
D.S SD:0x10232060 %LE %LONG 0x00000000;
D.S SD:0x10232060 %LE %LONG 0x00000000;
D.S SD:0x10232060 %LE %LONG 0x00000000;
D.S SD:0x10232060 %LE %LONG 0x00000000;

D.S SD:0x1022A060 %LE %LONG 0x00000000;

;wait 1.ms
D.S SD:0x10232060 %LE %LONG 0x00000000;
D.S SD:0x10232060 %LE %LONG 0x00000000;
D.S SD:0x10232060 %LE %LONG 0x00000000;
D.S SD:0x10232060 %LE %LONG 0x00000000;
D.S SD:0x10232060 %LE %LONG 0x00000000;
D.S SD:0x10232060 %LE %LONG 0x00000000;
D.S SD:0x10232060 %LE %LONG 0x00000000;
D.S SD:0x10232060 %LE %LONG 0x00000000;
D.S SD:0x10232060 %LE %LONG 0x00000000;

D.S SD:0x1022A05c %LE %LONG 0x01000183;
D.S SD:0x1022A060 %LE %LONG 0x00000001;

;wait 1.ms
D.S SD:0x10232060 %LE %LONG 0x00000000;
D.S SD:0x10232060 %LE %LONG 0x00000000;
D.S SD:0x10232060 %LE %LONG 0x00000000;
D.S SD:0x10232060 %LE %LONG 0x00000000;
D.S SD:0x10232060 %LE %LONG 0x00000000;
D.S SD:0x10232060 %LE %LONG 0x00000000;
D.S SD:0x10232060 %LE %LONG 0x00000000;
D.S SD:0x10232060 %LE %LONG 0x00000000;
D.S SD:0x10232060 %LE %LONG 0x00000000;

D.S SD:0x1022A060 %LE %LONG 0x00000000;
D.S SD:0x1022A05c %LE %LONG 0x01000206;  ;RL/WL
D.S SD:0x1022A060 %LE %LONG 0x00000001;

;wait 1.ms
D.S SD:0x10232060 %LE %LONG 0x00000000;
D.S SD:0x10232060 %LE %LONG 0x00000000;
D.S SD:0x10232060 %LE %LONG 0x00000000;
D.S SD:0x10232060 %LE %LONG 0x00000000;
D.S SD:0x10232060 %LE %LONG 0x00000000;
D.S SD:0x10232060 %LE %LONG 0x00000000;
D.S SD:0x10232060 %LE %LONG 0x00000000;
D.S SD:0x10232060 %LE %LONG 0x00000000;
D.S SD:0x10232060 %LE %LONG 0x00000000;

D.S SD:0x1022A060 %LE %LONG 0x00000000;
D.S SD:0x1022A05c %LE %LONG 0x01000b03; 
D.S SD:0x1022A060 %LE %LONG 0x00000001;
;;wait 1.ms
D.S SD:0x10232060 %LE %LONG 0x00000000;
D.S SD:0x10232060 %LE %LONG 0x00000000;
D.S SD:0x10232060 %LE %LONG 0x00000000;
D.S SD:0x10232060 %LE %LONG 0x00000000;
D.S SD:0x10232060 %LE %LONG 0x00000000;
D.S SD:0x10232060 %LE %LONG 0x00000000;
D.S SD:0x10232060 %LE %LONG 0x00000000;
D.S SD:0x10232060 %LE %LONG 0x00000000;
D.S SD:0x10232060 %LE %LONG 0x00000000;
;================== end RANK1 MRW =====================


D.S SD:0x1022A060 %LE %LONG 0x00000000;
D.S SD:0x1022A024 %LE %LONG 0x80030040;

;wait 1.ms
D.S SD:0x10232060 %LE %LONG 0x00000000;
D.S SD:0x10232060 %LE %LONG 0x00000000;
D.S SD:0x10232060 %LE %LONG 0x00000000;
D.S SD:0x10232060 %LE %LONG 0x00000000;
D.S SD:0x10232060 %LE %LONG 0x00000000;
D.S SD:0x10232060 %LE %LONG 0x00000000;
D.S SD:0x10232060 %LE %LONG 0x00000000;
D.S SD:0x10232060 %LE %LONG 0x00000000;
D.S SD:0x10232060 %LE %LONG 0x00000000;


D.S SD:0x1022A05c %LE %LONG 0x00000400;

  

D.S SD:0x1022A84c %LE %LONG 0x00000005;

;wait 1.ms
D.S SD:0x10232060 %LE %LONG 0x00000000;
D.S SD:0x10232060 %LE %LONG 0x00000000;
D.S SD:0x10232060 %LE %LONG 0x00000000;
D.S SD:0x10232060 %LE %LONG 0x00000000;
D.S SD:0x10232060 %LE %LONG 0x00000000;
D.S SD:0x10232060 %LE %LONG 0x00000000;
D.S SD:0x10232060 %LE %LONG 0x00000000;
D.S SD:0x10232060 %LE %LONG 0x00000000;
D.S SD:0x10232060 %LE %LONG 0x00000000;

D.S SD:0x1022A04c %LE %LONG 0x25774001;
D.S SD:0x1022A034 %LE %LONG 0x00731810;
D.S SD:0x1022A024 %LE %LONG 0x80030000;
D.S SD:0x1022A004 %LE %LONG 0x20082000;
D.S SD:0x1022A058 %LE %LONG 0x00000a56;

;wait 1.ms
D.S SD:0x10232060 %LE %LONG 0x00000000;
D.S SD:0x10232060 %LE %LONG 0x00000000;
D.S SD:0x10232060 %LE %LONG 0x00000000;
D.S SD:0x10232060 %LE %LONG 0x00000000;
D.S SD:0x10232060 %LE %LONG 0x00000000;
D.S SD:0x10232060 %LE %LONG 0x00000000;
D.S SD:0x10232060 %LE %LONG 0x00000000;
D.S SD:0x10232060 %LE %LONG 0x00000000;
D.S SD:0x10232060 %LE %LONG 0x00000000;


D.S SD:0x1022A84c %LE %LONG 0x00ff0005;
D.S SD:0x1022A064 %LE %LONG 0x25b1f1cf; ;REFRDIS=1
D.S SD:0x1022A810 %LE %LONG 0x22653055;
D.S SD:0x1022A04c %LE %LONG 0x45774001;
D.S SD:0x1022A048 %LE %LONG 0x48000000;
D.S SD:0x1022A05c %LE %LONG 0x80000400;
D.S SD:0x1022A038 %LE %LONG 0xc0000107;
D.S SD:0x1022A20c %LE %LONG 0x00010002;
D.S SD:0x1022A204 %LE %LONG 0x00014e00;
D.S SD:0x1022A094 %LE %LONG 0x00100000;
D.S SD:0x1022A098 %LE %LONG 0x00004000;
D.S SD:0x1022A09c %LE %LONG 0x12010480;
;               54377 === DE initial sequence done ===

;selftest
;D.S SD:0x1022A09C %LE %LONG 0x02010080;
;D.S SD:0x1022A094 %LE %LONG 0x00100000;
;D.S SD:0x1022A098 %LE %LONG 0x00004000;
;D.S SD:0x1022A09C %LE %LONG 0x82010080;
;wait 1.ms
D.S SD:0x10232060 %LE %LONG 0x00000000;
D.S SD:0x10232060 %LE %LONG 0x00000000;
D.S SD:0x10232060 %LE %LONG 0x00000000;
D.S SD:0x10232060 %LE %LONG 0x00000000;
D.S SD:0x10232060 %LE %LONG 0x00000000;
D.S SD:0x10232060 %LE %LONG 0x00000000;
D.S SD:0x10232060 %LE %LONG 0x00000000;
D.S SD:0x10232060 %LE %LONG 0x00000000;
D.S SD:0x10232060 %LE %LONG 0x00000000;
D.S SD:0x10232060 %LE %LONG 0x00000000;
D.S SD:0x10232060 %LE %LONG 0x00000000;
D.S SD:0x10232060 %LE %LONG 0x00000000;
D.S SD:0x10232060 %LE %LONG 0x00000000;
D.S SD:0x10232060 %LE %LONG 0x00000000;
D.S SD:0x10232060 %LE %LONG 0x00000000;
D.S SD:0x10232060 %LE %LONG 0x00000000;
D.S SD:0x10232060 %LE %LONG 0x00000000;
D.S SD:0x10232060 %LE %LONG 0x00000000;
